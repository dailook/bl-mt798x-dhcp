## atf-20240117-bacca82a8/plat/mediatek/mt7981/Config.in
```kconfig
# SPDX-License-Identifier: GPL-2.0 OR BSD-3-Clause
#
# Copyright (c) 2026 Yuzhii0718
#
# MT7981 platform-specific configurations
#

if _PLAT_MT7981

choice
	prompt "MT7981 ARMPLL frequency (MHz)"
	depends on _PLAT_MT7981
	default MT7981_ARMPLL_FREQ_1300

config MT7981_ARMPLL_FREQ_1300
	bool "1300 MHz (default)"
config MT7981_ARMPLL_FREQ_1400
	bool "1400 MHz"
config MT7981_ARMPLL_FREQ_1500
	bool "1500 MHz"
config MT7981_ARMPLL_FREQ_1600
	bool "1600 MHz"
config MT7981_ARMPLL_FREQ_1700
	bool "1700 MHz"
config MT7981_ARMPLL_FREQ_1800
	bool "1800 MHz"

endchoice

# Makefile/C option bridge for MT7981 ARMPLL frequency selection.
config MT7981_ARMPLL_FREQ_MHZ
	int
	depends on _PLAT_MT7981
	default 1300 if MT7981_ARMPLL_FREQ_1300
	default 1400 if MT7981_ARMPLL_FREQ_1400
	default 1500 if MT7981_ARMPLL_FREQ_1500
	default 1600 if MT7981_ARMPLL_FREQ_1600
	default 1700 if MT7981_ARMPLL_FREQ_1700
	default 1800 if MT7981_ARMPLL_FREQ_1800

endif # _PLAT_MT7981
```

## atf-20250711/plat/mediatek/mt7622/Config.in
```kconfig
# SPDX-License-Identifier: GPL-2.0 OR BSD-3-Clause
#
# Copyright (c) 2026 Yuzhii0718
#
# MT7622 platform-specific configurations
#

if _PLAT_MT7622

choice
	prompt "MT7622 ARMPLL frequency (MHz)"
	depends on _PLAT_MT7622
	default MT7622_ARMPLL_FREQ_1350

config MT7622_ARMPLL_FREQ_1350
	bool "1350 MHz (default)"
config MT7622_ARMPLL_FREQ_1400
	bool "1400 MHz"
config MT7622_ARMPLL_FREQ_1450
	bool "1450 MHz"
config MT7622_ARMPLL_FREQ_1500
	bool "1500 MHz"
config MT7622_ARMPLL_FREQ_1550
	bool "1550 MHz"
config MT7622_ARMPLL_FREQ_1600
	bool "1600 MHz"
config MT7622_ARMPLL_FREQ_1650
	bool "1650 MHz"
config MT7622_ARMPLL_FREQ_1700
	bool "1700 MHz"

endchoice

# Makefile/C option bridge for MT7622 ARMPLL frequency selection.
config MT7622_ARMPLL_FREQ_MHZ
	int
	depends on _PLAT_MT7622
	default 1350 if MT7622_ARMPLL_FREQ_1350
	default 1400 if MT7622_ARMPLL_FREQ_1400
	default 1450 if MT7622_ARMPLL_FREQ_1450
	default 1500 if MT7622_ARMPLL_FREQ_1500
	default 1550 if MT7622_ARMPLL_FREQ_1550
	default 1600 if MT7622_ARMPLL_FREQ_1600
	default 1650 if MT7622_ARMPLL_FREQ_1650
	default 1700 if MT7622_ARMPLL_FREQ_1700

endif # _PLAT_MT7622
```

## atf-20250711/plat/mediatek/mt7629/Config.in
```kconfig
# SPDX-License-Identifier: GPL-2.0 OR BSD-3-Clause
#
# Copyright (c) 2026 Yuzhii0718
#
# MT7629 platform-specific configurations
#

if _PLAT_MT7629

choice
	prompt "MT7629 ARMPLL frequency (MHz)"
	depends on _PLAT_MT7629
	default MT7629_ARMPLL_FREQ_1200

config MT7629_ARMPLL_FREQ_1200
	bool "1200 MHz (default)"
config MT7629_ARMPLL_FREQ_1250
	bool "1250 MHz"
config MT7629_ARMPLL_FREQ_1300
	bool "1300 MHz"
config MT7629_ARMPLL_FREQ_1350
	bool "1350 MHz"
config MT7629_ARMPLL_FREQ_1400
	bool "1400 MHz"
config MT7629_ARMPLL_FREQ_1450
	bool "1450 MHz"
config MT7629_ARMPLL_FREQ_1500
	bool "1500 MHz"

endchoice

# Makefile/C option bridge for MT7629 ARMPLL frequency selection.
config MT7629_ARMPLL_FREQ_MHZ
	int
	depends on _PLAT_MT7629
	default 1200 if MT7629_ARMPLL_FREQ_1200
	default 1250 if MT7629_ARMPLL_FREQ_1250
	default 1300 if MT7629_ARMPLL_FREQ_1300
	default 1350 if MT7629_ARMPLL_FREQ_1350
	default 1400 if MT7629_ARMPLL_FREQ_1400
	default 1450 if MT7629_ARMPLL_FREQ_1450
	default 1500 if MT7629_ARMPLL_FREQ_1500

endif # _PLAT_MT7629
```

## atf-20250711/plat/mediatek/mt7987/Config.in
```kconfig
# SPDX-License-Identifier: BSD-3-Clause
#
# Copyright (c) 2025 Daniel Golle <daniel@makrotopia.org>
# Copyright (c) 2026 Yuzhii0718 <admin@yuzhii0718.eu.org>
#
# MT7987 platform-specific configurations
#

if _PLAT_MT7987

config _ENABLE_I2P5G_PHY
	bool "Enable internal 2.5G PHY support"
	default y
	select _SUPPORTS_I2P5G_PHY

choice
	prompt "Internal 2.5G PHY mode"
	depends on _SUPPORTS_I2P5G_PHY
	default _I2P5G_PHY_1P2L

	config _I2P5G_PHY_1P2L
		bool "1 port 2 lane"

	config _I2P5G_PHY_2P1L
		bool "2 port 1 lane"

endchoice

config I2P5G_PHY_MODE
	int
	default 0 if _I2P5G_PHY_1P2L
	default 1 if _I2P5G_PHY_2P1L

choice
	prompt "SPI controller"
	depends on (_BOOT_DEVICE_SPIM_NAND || _BOOT_DEVICE_SPI_NOR)
	default _SPIM_CTRL_0 if _BOOT_DEVICE_SPIM_NAND
	default _SPIM_CTRL_2 if _BOOT_DEVICE_SPI_NOR

	config _SPIM_CTRL_0
		bool "0"

	config _SPIM_CTRL_2
		bool "2"

endchoice

config SPIM_CTRL
	int
	default 0 if _SPIM_CTRL_0
	default 2 if _SPIM_CTRL_2

endif # _PLAT_MT7987
```

## uboot-mtk-20250711/configs-fit/mt7986_bpi_r3mini-emmc_defconfig
```kconfig
CONFIG_ARM=y
CONFIG_SYS_HAS_NONCACHED_MEMORY=y
CONFIG_POSITION_INDEPENDENT=y
CONFIG_ARCH_MEDIATEK=y
CONFIG_TEXT_BASE=0x41e00000
CONFIG_SYS_MALLOC_F_LEN=0x4000
CONFIG_NR_DRAM_BANKS=1
CONFIG_DEFAULT_DEVICE_TREE="mt7986a-bpi_r3mini-emmc"
CONFIG_SYS_PROMPT="MT7986> "
CONFIG_TARGET_MT7986=y
CONFIG_DEBUG_UART_BASE=0x11002000
CONFIG_DEBUG_UART_CLOCK=40000000
CONFIG_SYS_LOAD_ADDR=0x46000000
CONFIG_PCI=y
CONFIG_DEBUG_UART=y
CONFIG_MEDIATEK_BOOTMENU=y
CONFIG_MTK_BOOTMENU_MMC=y
CONFIG_MTK_WEB_FAILSAFE=y
CONFIG_MTK_WEB_FAILSAFE_AFTER_BOOT_FAILURE=y
CONFIG_MTK_UPGRADE_BL2_VERIFY=y
# CONFIG_MTK_UPGRADE_FIP_VERIFY is not set
CONFIG_FIT=y
CONFIG_AUTOBOOT_MENU_SHOW=y
CONFIG_AUTOBOOT_MENU_MTK_SHOW=y
CONFIG_DEFAULT_FDT_FILE="mt7986a-bpi_r3mini-emmc"
CONFIG_LOGLEVEL=7
CONFIG_LOG=y
CONFIG_HUSH_PARSER=y
CONFIG_SYS_CBSIZE=512
CONFIG_SYS_PBSIZE=1049
# CONFIG_BOOTM_NETBSD is not set
# CONFIG_BOOTM_PLAN9 is not set
# CONFIG_BOOTM_RTEMS is not set
# CONFIG_BOOTM_VXWORKS is not set
# CONFIG_CMD_ELF is not set
CONFIG_CMD_MEMINFO=y
# CONFIG_CMD_UNLZ4 is not set
# CONFIG_CMD_UNZIP is not set
CONFIG_CMD_GPIO=y
CONFIG_CMD_GPIO_READ=y
CONFIG_CMD_GPT=y
CONFIG_CMD_GPT_RENAME=y
CONFIG_CMD_LSBLK=y
CONFIG_CMD_MMC=y
CONFIG_CMD_PART=y
CONFIG_CMD_TFTPPUT=y
CONFIG_CMD_READ=y
CONFIG_CMD_PING=y
CONFIG_CMD_SMC=y
CONFIG_CMD_FAT=y
CONFIG_CMD_FS_GENERIC=y
CONFIG_CMD_GL_BTN=y
CONFIG_PARTITION_TYPE_GUID=y
CONFIG_OF_EMBED=y
CONFIG_ENV_OVERWRITE=y
CONFIG_ENV_VARS_UBOOT_RUNTIME_CONFIG=y
CONFIG_NET_RANDOM_ETHADDR=y
CONFIG_NET_FORCE_IPADDR=y
CONFIG_USE_IPADDR=y
CONFIG_IPADDR="192.168.1.1"
CONFIG_USE_NETMASK=y
CONFIG_NETMASK="255.255.255.0"
CONFIG_USE_SERVERIP=y
CONFIG_SERVERIP="192.168.1.2"
CONFIG_PROT_TCP=y
CONFIG_REGMAP=y
CONFIG_SYSCON=y
CONFIG_BUTTON=y
CONFIG_BUTTON_GPIO=y
CONFIG_CLK=y
CONFIG_LED=y
CONFIG_LED_BLINK=y
CONFIG_LED_GPIO=y
CONFIG_MMC_HS200_SUPPORT=y
CONFIG_MMC_MTK=y
CONFIG_PHY_FIXED=y
CONFIG_MEDIATEK_ETH=y
CONFIG_PINCTRL=y
CONFIG_PINCONF=y
CONFIG_PINCTRL_MT7986=y
CONFIG_POWER_DOMAIN=y
CONFIG_MTK_POWER_DOMAIN=y
CONFIG_DM_REGULATOR=y
CONFIG_DM_REGULATOR_FIXED=y
CONFIG_DM_REGULATOR_GPIO=y
CONFIG_DM_SERIAL=y
CONFIG_MTK_SERIAL=y
CONFIG_FAT_WRITE=y
CONFIG_HEXDUMP=y
CONFIG_TIMER=y
CONFIG_MTK_TIMER=y
# CONFIG_EFI_LOADER is not set
# CONFIG_SYS_I2C_MTK is not set
CONFIG_POLLER=y
CONFIG_USE_BOOTARGS=y
CONFIG_BOOTARGS="root=/dev/fit0 rootwait"
CONFIG_PRE_CON_BUF_ADDR=0x4007EF00
CONFIG_ENV_IS_IN_MMC=y
CONFIG_ENV_REDUNDANT=y
CONFIG_ENV_SIZE=0x40000
CONFIG_ENV_OFFSET=0x400000
CONFIG_ENV_OFFSET_REDUND=0x440000
CONFIG_SYS_REDUNDAND_ENVIRONMENT=y
CONFIG_PHY_AIROHA=y
CONFIG_PHY_AIROHA_EN8811H=y
CONFIG_PHY_ETHERNET_ID=y
CONFIG_PCIE_MEDIATEK=y
CONFIG_PHY=y
CONFIG_PHY_MTK_TPHY=y
CONFIG_DM_PWM=y
CONFIG_PWM_MTK=y
CONFIG_CMD_PWM=y
CONFIG_USB=y
CONFIG_USB_XHCI_HCD=y
CONFIG_USB_XHCI_MTK=y
CONFIG_USB_STORAGE=y
CONFIG_AHCI=y
CONFIG_SCSI_AHCI=y
CONFIG_AHCI_PCI=y
CONFIG_MTK_AHCI=y
CONFIG_CMD_FS_UUID=y
CONFIG_CMD_ERASEENV=y
CONFIG_CMD_CLK=y
CONFIG_CMD_STRINGS=y
CONFIG_CMD_LED_BLINK=y
CONFIG_CMD_BOOTMENU=y
CONFIG_DM_MDIO=y
CONFIG_CMD_DM=y
CONFIG_DM_ETH_PHY=y
CONFIG_DM_ETH=y
CONFIG_GPIO_HOG=y
CONFIG_RAM=y
CONFIG_SCSI=y
CONFIG_SERIAL_RX_BUFFER=y
```

## uboot-mtk-20250711/configs-openwrt/mt7981_gatonetworks_gdsp_defconfig
```kconfig
CONFIG_ARM=y
CONFIG_ARM_SMCCC=y
CONFIG_SYS_HAS_NONCACHED_MEMORY=y
CONFIG_POSITION_INDEPENDENT=y
CONFIG_ARCH_MEDIATEK=y
CONFIG_TEXT_BASE=0x41e00000
CONFIG_SYS_MALLOC_F_LEN=0x4000
CONFIG_NR_DRAM_BANKS=1
CONFIG_ENV_SIZE=0x10000
CONFIG_ENV_OFFSET=0x0
CONFIG_DEFAULT_DEVICE_TREE="mediatek/openwrt/mt7981-gatonetworks_gdsp"
CONFIG_OF_LIBFDT_OVERLAY=y
CONFIG_TARGET_MT7981=y
CONFIG_SYS_LOAD_ADDR=0x46000000
CONFIG_WATCHDOG_TIMEOUT_MSECS=25000
CONFIG_DEBUG_UART_BASE=0x11002000
CONFIG_DEBUG_UART_CLOCK=40000000
CONFIG_DEBUG_UART=y
CONFIG_FIT=y
CONFIG_SPI_BOOT=y
CONFIG_AUTOBOOT_MENU_SHOW=y
CONFIG_USE_PREBOOT=y
CONFIG_DEFAULT_FDT_FILE="mt7981-gatonetworks_gdsp"
CONFIG_SYS_CBSIZE=512
CONFIG_SYS_PBSIZE=1049
CONFIG_LOGLEVEL=7
CONFIG_CONSOLE_MUX=y
CONFIG_LOG=y
CONFIG_HUSH_PARSER=y
CONFIG_SYS_PROMPT="GDSP> "
CONFIG_SYS_MAXARGS=16
CONFIG_CMD_BDINFO_EXTRA=y
CONFIG_CMD_CPU=y
CONFIG_CMD_HISTORY=y
CONFIG_CMD_LICENSE=y
# CONFIG_BOOTM_NETBSD is not set
# CONFIG_BOOTM_PLAN9 is not set
# CONFIG_BOOTM_RTEMS is not set
# CONFIG_BOOTM_VXWORKS is not set
# CONFIG_CMD_BOOTEFI_BOOTMGR is not set
CONFIG_CMD_BOOTMENU=y
CONFIG_CMD_ASKENV=y
CONFIG_CMD_ERASEENV=y
CONFIG_CMD_ENV_CALLBACK=y
CONFIG_CMD_ENV_FLAGS=y
CONFIG_CRC32_VERIFY=y
CONFIG_LOOPW=y
CONFIG_CMD_MEMINFO=y
CONFIG_CMD_MEMTEST=y
CONFIG_CMD_RNG=y
CONFIG_CMD_STRINGS=y
# CONFIG_CMD_UNLZ4 is not set
# CONFIG_CMD_UNZIP is not set
CONFIG_CMD_DM=y
CONFIG_CMD_GPIO=y
CONFIG_CMD_GPIO_READ=y
CONFIG_CMD_PWM=y
CONFIG_CMD_MMC=y
CONFIG_CMD_MTD=y
# CONFIG_CMD_NAND_EXT is not set
CONFIG_CMD_PART=y
CONFIG_CMD_SF_TEST=y
CONFIG_CMD_CAT=y
CONFIG_CMD_SETEXPR_FMT=y
CONFIG_CMD_XXD=y
CONFIG_CMD_TFTPPUT=y
CONFIG_CMD_TFTPSRV=y
CONFIG_CMD_RARP=y
CONFIG_CMD_CDP=y
CONFIG_CMD_SNTP=y
CONFIG_CMD_LINK_LOCAL=y
CONFIG_CMD_DHCP=y
CONFIG_CMD_DNS=y
CONFIG_CMD_PING=y
CONFIG_CMD_PXE=y
CONFIG_CMD_CACHE=y
# CONFIG_CMD_EFICONFIG is not set
CONFIG_CMD_PSTORE=y
CONFIG_CMD_PSTORE_MEM_ADDR=0x42ff0000
CONFIG_CMD_UUID=y
CONFIG_CMD_HASH=y
CONFIG_CMD_SMC=y
CONFIG_CMD_FAT=y
CONFIG_CMD_FS_GENERIC=y
CONFIG_CMD_FS_UUID=y
CONFIG_EFI_PARTITION=y
CONFIG_ENV_OVERWRITE=y
CONFIG_ENV_IS_IN_MTD=y
CONFIG_ENV_RELOC_GD_ENV_ADDR=y
CONFIG_ENV_MTD_DEV="u-boot-env"
CONFIG_ENV_USE_DEFAULT_ENV_TEXT_FILE=y
CONFIG_ENV_DEFAULT_ENV_TEXT_FILE="defenvs/gatonetworks_gdsp_env"
CONFIG_ENV_VARS_UBOOT_RUNTIME_CONFIG=y
CONFIG_VERSION_VARIABLE=y
CONFIG_NETCONSOLE=y
CONFIG_NET_RANDOM_ETHADDR=y
CONFIG_BUTTON=y
CONFIG_BUTTON_GPIO=y
CONFIG_CLK=y
CONFIG_GPIO_HOG=y
CONFIG_LED=y
CONFIG_LED_BLINK=y
CONFIG_LED_GPIO=y
# CONFIG_MMC_HW_PARTITIONING is not set
CONFIG_MMC_MTK=y
CONFIG_MTD=y
CONFIG_DM_MTD=y
CONFIG_MTD_SPI_NAND=y
CONFIG_DM_SPI_FLASH=y
CONFIG_SPI_FLASH_SFDP_SUPPORT=y
CONFIG_SPI_FLASH_EON=y
CONFIG_SPI_FLASH_GIGADEVICE=y
CONFIG_SPI_FLASH_ISSI=y
CONFIG_SPI_FLASH_MACRONIX=y
CONFIG_SPI_FLASH_SPANSION=y
CONFIG_SPI_FLASH_STMICRO=y
CONFIG_SPI_FLASH_WINBOND=y
CONFIG_SPI_FLASH_XMC=y
CONFIG_SPI_FLASH_XTX=y
CONFIG_SPI_FLASH_MTD=y
CONFIG_UBI_SILENCE_MSG=y
CONFIG_PHY_FIXED=y
CONFIG_MEDIATEK_ETH=y
CONFIG_PHY=y
CONFIG_PHY_MTK_TPHY=y
CONFIG_PINCTRL=y
CONFIG_PINCONF=y
CONFIG_PINCTRL_MT7981=y
CONFIG_POWER_DOMAIN=y
CONFIG_MTK_POWER_DOMAIN=y
CONFIG_DM_PWM=y
CONFIG_PWM_MTK=y
CONFIG_DM_RNG=y
CONFIG_RNG_MTK_V2=y
CONFIG_DM_SERIAL=y
CONFIG_SERIAL_RX_BUFFER=y
CONFIG_MTK_SERIAL=y
CONFIG_SPI=y
CONFIG_DM_SPI=y
CONFIG_MTK_SPIM=y
CONFIG_USB=y
CONFIG_USB_XHCI_HCD=y
CONFIG_USB_XHCI_MTK=y
CONFIG_USB_STORAGE=y
CONFIG_WDT=y
CONFIG_WDT_GPIO=y
CONFIG_UBIFS_SILENCE_MSG=y
CONFIG_HEXDUMP=y
```

## uboot-mtk-20250711/configs-openwrt/mt7981_glinet_gl-mt2500_defconfig
```kconfig
CONFIG_ARM=y
CONFIG_ARM_SMCCC=y
CONFIG_SYS_HAS_NONCACHED_MEMORY=y
CONFIG_POSITION_INDEPENDENT=y
CONFIG_ARCH_MEDIATEK=y
CONFIG_TEXT_BASE=0x41e00000
CONFIG_SYS_MALLOC_F_LEN=0x4000
CONFIG_NR_DRAM_BANKS=1
CONFIG_ENV_SIZE=0x80000
CONFIG_ENV_OFFSET=0x400000
CONFIG_DEFAULT_DEVICE_TREE="mediatek/openwrt/mt7981-glinet-gl-mt2500"
CONFIG_OF_LIBFDT_OVERLAY=y
CONFIG_TARGET_MT7981=y
CONFIG_SYS_LOAD_ADDR=0x46000000
CONFIG_DEBUG_UART_BASE=0x11002000
CONFIG_DEBUG_UART_CLOCK=40000000
CONFIG_DEBUG_UART=y
CONFIG_ENV_VARS_UBOOT_CONFIG=y
# CONFIG_EXPERT is not set
# CONFIG_EFI_LOADER is not set
CONFIG_FIT=y
# CONFIG_BOOTSTD is not set
# CONFIG_LEGACY_IMAGE_FORMAT is not set
CONFIG_AUTOBOOT_MENU_SHOW=y
CONFIG_USE_BOOTCOMMAND=y
CONFIG_DEFAULT_FDT_FILE="mediatek/mt7981-glinet-gl-mt2500.dtb"
CONFIG_SYS_CBSIZE=512
CONFIG_SYS_PBSIZE=1049
CONFIG_LOGLEVEL=7
CONFIG_CONSOLE_MUX=y
CONFIG_SYS_CONSOLE_ENV_OVERWRITE=y
CONFIG_HUSH_PARSER=y
CONFIG_SYS_PROMPT="GL-MT2500> "
CONFIG_CMD_CPU=y
CONFIG_CMD_LICENSE=y
# CONFIG_BOOTM_NETBSD is not set
# CONFIG_BOOTM_PLAN9 is not set
# CONFIG_BOOTM_RTEMS is not set
# CONFIG_BOOTM_VXWORKS is not set
CONFIG_CMD_BOOTMENU=y
# CONFIG_CMD_ELF is not set
CONFIG_CMD_ASKENV=y
CONFIG_CMD_ERASEENV=y
CONFIG_CMD_ENV_CALLBACK=y
CONFIG_CMD_ENV_FLAGS=y
CONFIG_CMD_RNG=y
CONFIG_CMD_STRINGS=y
# CONFIG_CMD_UNLZ4 is not set
# CONFIG_CMD_UNZIP is not set
CONFIG_CMD_DM=y
CONFIG_CMD_GPIO=y
CONFIG_CMD_GPT=y
CONFIG_CMD_GPT_RENAME=y
CONFIG_CMD_MMC=y
CONFIG_CMD_PART=y
CONFIG_CMD_READ=y
CONFIG_CMD_USB=y
CONFIG_CMD_WRITE=y
CONFIG_CMD_SETEXPR_FMT=y
CONFIG_CMD_XXD=y
CONFIG_CMD_TFTPSRV=y
CONFIG_CMD_RARP=y
CONFIG_CMD_CDP=y
CONFIG_CMD_SNTP=y
CONFIG_CMD_LINK_LOCAL=y
CONFIG_CMD_DHCP=y
CONFIG_CMD_DNS=y
CONFIG_CMD_PING=y
CONFIG_CMD_WGET=y
CONFIG_CMD_PXE=y
CONFIG_CMD_CACHE=y
CONFIG_CMD_PSTORE=y
CONFIG_CMD_PSTORE_MEM_ADDR=0x42ff0000
CONFIG_CMD_UUID=y
CONFIG_CMD_HASH=y
CONFIG_CMD_SMC=y
CONFIG_CMD_FAT=y
CONFIG_PARTITION_TYPE_GUID=y
CONFIG_ENV_OVERWRITE=y
CONFIG_ENV_IS_IN_MMC=y
CONFIG_ENV_USE_DEFAULT_ENV_TEXT_FILE=y
CONFIG_ENV_DEFAULT_ENV_TEXT_FILE="defenvs/glinet_gl-mt2500_env"
CONFIG_ENV_VARS_UBOOT_RUNTIME_CONFIG=y
CONFIG_VERSION_VARIABLE=y
CONFIG_NETCONSOLE=y
CONFIG_NET_RANDOM_ETHADDR=y
CONFIG_REGMAP=y
CONFIG_SYSCON=y
CONFIG_BUTTON=y
CONFIG_BUTTON_GPIO=y
CONFIG_CLK=y
CONFIG_GPIO_HOG=y
CONFIG_LED=y
CONFIG_LED_BLINK=y
CONFIG_LED_GPIO=y
CONFIG_MMC_HS200_SUPPORT=y
CONFIG_MMC_MTK=y
CONFIG_PHY_FIXED=y
CONFIG_MEDIATEK_ETH=y
CONFIG_PINCTRL=y
CONFIG_PINCONF=y
CONFIG_PINCTRL_MT7981=y
CONFIG_POWER_DOMAIN=y
CONFIG_MTK_POWER_DOMAIN=y
CONFIG_DM_REGULATOR=y
CONFIG_DM_REGULATOR_FIXED=y
CONFIG_DM_RNG=y
CONFIG_RNG_MTK_V2=y
CONFIG_DM_SERIAL=y
CONFIG_SERIAL_RX_BUFFER=y
CONFIG_MTK_SERIAL=y
CONFIG_USB=y
CONFIG_USB_XHCI_HCD=y
CONFIG_USB_XHCI_MTK=y
CONFIG_USB_STORAGE=y
CONFIG_HEXDUMP=y
```
