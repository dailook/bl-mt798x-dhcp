// SPDX-License-Identifier: GPL-2.0

/dts-v1/;
#include "mt7987a-emmc-airpi-e87n-common.dtsi"

/ {
	model = "MediaTek MT7987 EMMC airpi E87N";
	compatible = "mediatek,mt7987", "mediatek,mt7987-emmc-rfb",
			"mediatek,mt7987a";
};

&eth0 {
	status = "okay";
	phy-mode = "2500base-x";
	phy-handle = <&phy3>;

	phy3: ethernet-phy@3 {
		compatible = "ethernet-phy-ieee802.3-c45";
		reg = <3>;
		reset-assert-us = <100000>;
		reset-deassert-us = <100000>;
		reset-gpios = <&pio 42 GPIO_ACTIVE_LOW>;
		interrupts = <41 IRQ_TYPE_LEVEL_LOW>;
		interrupt-parent = <&pio>;
		realtek,aldps-enable;
		realtek,led-link-select = <0xa7 0xa7 0x0>;
	};
};
